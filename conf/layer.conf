## conf/layer.conf
```bitbake
BBFILES += " ${LAYERDIR}/recipes-*/*.bb \
             ${LAYERDIR}/recipes-*/*.bbappend \
             ${LAYERDIR}/recipes-*/*/*.bb \
             ${LAYERDIR}/recipes-*/*/*.bbappend"
BBPATH .= ":${LAYERDIR}"
BBFILE_COLLECTIONS += "qti-auto-sepolicy"
BBFILE_PRIORITY_qti-auto-sepolicy = "12"
BBFILE_PATTERN_qti-auto-sepolicy := "^${LAYERDIR}/"

LAYERSERIES_COMPAT_qti-auto-sepolicy = "kirkstone scarthgap"

SELINUX_FILE_CONTEXTS_SYSTEMRW ?= "${IMAGE_ROOTFS}/etc/selinux/mls/contexts/files/systemrw_file_contexts"
```
